## boards/mnt/reform_ortho/Kconfig
```kconfig
# SPDX-License-Identifier: GPL-3.0-or-later
# Copyright 2026 Gordon Q

config BOARD_REFORM_ORTHO
    select RP2_FLASH_W25Q080
```

## boards/mnt/reform_ortho/Kconfig.reform_ortho
```kconfig
# SPDX-License-Identifier: GPL-3.0-or-later
# Copyright 2026 Gordon Q

config BOARD_REFORM_ORTHO
    select SOC_RP2040
```

## boards/mnt/reform_ortho/board.yml
```yaml
board:
  name: reform_ortho
  full_name: Reform Ortho
  vendor: mnt
  socs:
  - name: rp2040
```

## config/west.yml
```yaml
manifest:
  remotes:
    - name: zmkfirmware
      url-base: https://github.com/zmkfirmware
    - name: joguSD
      url-base: https://github.com/joguSD
    - name: petejohanson
      url-base: https://github.com/petejohanson
    - name: zzeneg
      url-base: https://github.com/zzeneg
  projects:
    - name: zmk
      remote: zmkfirmware
      revision: main
      import: app/west.yml
    - name: zmk-raw-hid
      remote: zzeneg
      revision: 6a37765dfab6197292e7a9f47305dcf87386d56a
  self:
    path: config
```

## dts/bindings/mnt,led-indicators.yaml
```yaml
# SPDX-License-Identifier: GPL-3.0-or-later
description: |
  Drives an LED strip from keyboard state and the host. Each child is a signal
  that paints its color on one LED while active; the channels a signal's color
  touches belong to the firmware, every other channel to the host.

compatible: "mnt,led-indicators"

properties:
  led-strip:
    type: phandle
    required: true

child-binding:
  description: Indicator signal
  properties:
    led:
      type: int
      required: true
      description: Index of the LED in the strip
    color:
      type: int
      required: true
      description: 0xRRGGBB shown while active; non-zero bytes are the channels it owns
    hid-indicators:
      type: int
      description: HID_INDICATOR_* bits; active while any of them is set
    layers:
      type: array
      description: Layer indices; active while any of them is active
```
